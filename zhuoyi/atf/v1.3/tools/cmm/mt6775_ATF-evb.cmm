;*****************************************************************************
;  Copyright Statement:
;  --------------------
;  This software is protected by Copyright and the information contained
;  herein is confidential. The software may not be copied and the information
;  contained herein may not be used or disclosed except with the written
;  permission of MediaTek Inc. (C) 2011
;
;*****************************************************************************
;;================================================
;; PURPOSE:     FPGA Bring Up
;; CREATE_DATE: 2017/09/28
;; NOTE:
;;================================================
; Specify Core Number
;=================================================

&NR_CPUS=1
; cluster 0 corebase: 0x8007000, 0x8007200, 0x8007400, 0x8007600
; cluster 1 corebase: 0x8009000, 0x8009200, 0x8009400, 0x8009600

;=================================================
; Initialize CPU
;=================================================
&WDT_TEST=0
if &WDT_TEST==0
(
	RESET
	SYSTEM.OPTION ENRESET ON
)

SYSTEM.RESET
SYSTEM.OPTION ENRESET ON
SYSTEM.OPTION RESBREAK OFF
SYSTEM.OPTION WAITRESET OFF

SYSTEM.JTAGCLOCK 10.MHz;

;SYSTEM.CPU CortexA7MPCore
SYStem.CPU CORTEXA53;

;R-T Memory Access
SYSTEM.MULTICORE MEMORYACCESSPORT 0
SYSTEM.MULTICORE DEBUGACCESSPORT 1

;SYSTEM.MULTICORE COREBASE APB:0x80070000
;Setting Core debug register access
if &NR_CPUS==1
(
    SYStem.CONFIG CORENUMBER 1;
    SYStem.CONFIG COREBASE 0x8D410000;
    SYStem.CONFIG CTIBASE 0x8D420000;
)
else
(
    SYSTEM.CONFIG CORENUMBER 2;
    SYSTEM.CONFIG COREBASE 0x80810000 0x80910000;
    SYStem.CONFIG CTIBASE 0x80820000 0x80920000;
)

;=================================================
; Attach and Stop CPU
;=================================================
SYStem.Up
wait 200.us

SETUP.IMASKHLL ON
SETUP.IMASKASM ON

;=================================================
; Initialize EMI
;=================================================
&init_emi=0 ; 0: not init
            ; 1: init
IF &init_emi==1
(
; Init DDR
;do MTxxxx_FPGA_DDR.cmm
  do Cannon_FPGA_DDR_V7
  wait 3000.ms
)

;enable L2C 256KB
D.S SD:0x0C5307F0 %LE %LONG 0x00010300 ;Enable L2C share SRAM (512K)
D.S SD:0x0C5307F0 %LE %LONG 0x00010301 ;Enable L2C share SRAM (512K)

; set_hw_breakpoint_by_def
; setting attribute of breakpoints
Break.Select Program OnChip
Break.Select Hll OnChip
Break.Select Spot OnChip
Break.Select Read OnChip
Break.Select Write OnChip

D.S C15:0x1 0				; Turn off MMU

; disable wdt (debug purpose)
D.S SD:0x10211000 %LE %LONG 0x22000000

; board init

Register.Set T 0 ; must

;set break point for tiny bootloader deadloop position
;b.s 0x205922

;PRINT "Wait preloader Enter while(1);"
;GO
;WAIT 3.s

;d.load.elf ../../bin/preloader.elf
; ABTC change the output folder
;
PRINT "Load preloader BIN(Binary Only)..."
;D.LOAD.ELF ../../../../../bootable/bootloader/preloader/bin/preloader.elf /noclear
D.LOAD.ELF ../../../../../../../../out/target/product/evb6775_64_emmc/obj/PRELOADER_OBJ/bin/preloader_evb6775_64_emmc.elf /noclear
;D.LOAD.BINARY ./bin/preloader_fpga6759_64_emmc_NO_GFH_NO_dram_init_NO_load_LK_ATF.bin 0x00201000 /noclear
;D.LOAD.BINARY ./bin/preloader_fpga6797_64_NO_GFH.bin 0x00201000 /noclear

; normal version lk
;D.LOAD.BINARY ../../../../../out/target/product/mtxxxx_fpga/obj/BOOTLOADER_OBJ/build-mtxxxx_fpga/lk-no-mtk-header.bin 0x41E00000 /noclear
;D.LOAD.BINARY ../../../../../out/target/product/evb6735_64_atf1/obj/BOOTLOADER_OBJ/build-evb6735_64_atf1/lk-no-mtk-header.bin 0x41E00000 /noclear
;D.LOAD.BINARY ./bin/mt6797_lk-no-mtk-header.bin 0x41E00000 /noclear
;d.load.elf ../../../../../out/target/product/fpga_everest_64/obj/BOOTLOADER_OBJ/build-fpga_everest_64/lk /noclear

;D.LOAD.BINARY ../../tools/cmm/bin/lk-no-mtk-header.bin 0x46000000 /noclear
;D.LOAD.BINARY ../../../../../../../../out/target/product/evb6775_64_emmc/obj/BOOTLOADER_OBJ/build-evb6775_64_emmc/lk-no-mtk-header.bin 0x46000000 /noclear

PRINT "Load ATF ELF..."
;d.load.elf ../../../out/build/debug/bl31/bl31.elf
;d.load.elf ../../../../../../../../out/target/product/evb6775_64_emmc/trustzone/ATF_OBJ/debug/bl31/bl31.elf /noclear
;d.load.elf ../../../../../../../../out/target/product/evb6775_64_emmc/trustzone/ATF_OBJ/debug/bl31/bl31.elf /nocode
;D.LOAD.BINARY ../../../../../../../../out/target/product/evb6775_64_emmc/trustzone/bin/sram_atf.img 0x100800 /noclear
;D.LOAD.BINARY ../../../../../../../../out/target/product/evb6775_64_emmc/trustzone/bin/dram_atf.img 0x54600000 /noclear

; /noclear means no clear symbol table
;d.load.elf ../../../../out/target/product/mtxxxx_fpga/obj/PRELOADER_OBJ/bin/preloader.elf /nocode

r.s pc 0x00201000

Register.Set T 0 ; must

PRINT "Wait preloader Enter while(1);"
;GO
;WAIT 3.s

Y.SPATH.RESET ; reset all source path
Y.SPATH.SRD ../../bl31
Y.SPATH.SRD ../../plat/mediatek/mt6769
Y.SPATH.SRD ../../services/spd/tspd
Y.SPATH.SRD ../../services/std_svc/psci
Y.SPATH.SRD ../../lib/aarch64

Break.Select Program OnChip
Break.Select Hll OnChip
Break.Select Spot OnChip
Break.Select Read OnChip
Break.Select Write OnChip

;set break point
;b.s 0x43001000
;b.s 0x205922
;b.s enable_mmu_el3
b.s bl31_main
b.s el3_exit
;b.s bl31_early_platform_setup
;b.s 0x4000c000
b.s 0x00101000
;b.s 0x41E00000
;b.s errata_a53_826319_wa

;PRINT "Wait preloader end and reload ATF sram/dram image"
GO
WAIT 25.s
; disable wdt (debug purpose)
D.S SD:0x10211000 %LE %LONG 0x22000000

D.LOAD.BINARY ../../../../../../../../out/target/product/evb6775_64_emmc/trustzone/bin/sram_atf.img 0x100800 /noclear
D.LOAD.BINARY ../../../../../../../../out/target/product/evb6775_64_emmc/trustzone/bin/dram_atf.img 0x54600000 /noclear
;d.load.elf ../../../../../../../../out/target/product/fpga6769_64_emmc/trustzone/ATF_OBJ/debug/bl31/bl31.elf
; simple uart log in lk
D.LOAD.BINARY ../../tools/cmm/bin/simple_uart_log_lk-no-mtk-header.bin 0x46000000 /noclear
;D.LOAD.BINARY ../../../../../../../../out/target/product/fpga6769_64_emmc/obj/BOOTLOADER_OBJ/build-fpga6769_64_emmc/lk-no-mtk-header.bin 0x46000000 /noclear

R.S T 0
;winclear
d.l
enddo
